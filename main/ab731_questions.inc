    { AB731_DOMAIN_VALUE,
      "A support bot must answer only from approved manuals. What helps most?",
      { "Higher temperature", "RAG grounding", "More colors", "No system prompt" },
      1, "RAG retrieves approved content and grounds the response." },
    { AB731_DOMAIN_VALUE,
      "Which factor commonly drives generative AI usage cost?",
      { "Office count", "Token volume", "Screen size", "Employee age" },
      1, "Input and output tokens are common usage-based cost drivers." },
    { AB731_DOMAIN_VALUE,
      "You predict invoice categories from labeled history. Best approach?",
      { "Supervised ML", "Image generation", "Random rules", "Text-to-speech" },
      0, "Labeled examples make this a supervised classification task." },
    { AB731_DOMAIN_VALUE,
      "When is a pretrained model the best first choice?",
      { "Common task, fast pilot", "Unique behavior required", "Fixed legal phrase", "Large labeled set" },
      0, "Start with a pretrained model when common capabilities meet the need." },
    { AB731_DOMAIN_VALUE,
      "A useful prompt should clearly state what?",
      { "Task and output format", "Only a broad topic", "Model internals", "Unrelated examples" },
      0, "Task, context, constraints, and output format improve consistency." },
    { AB731_DOMAIN_VALUE,
      "A training set underrepresents one customer group. Main risk?",
      { "Lower brightness", "Biased performance", "Free tokens", "Stronger login" },
      1, "Poor representation can produce unfair or unreliable outcomes." },
    { AB731_DOMAIN_VALUE,
      "What is the best first ROI measure for an AI pilot?",
      { "Business baseline", "Model name", "Logo quality", "Prompt length" },
      0, "Compare a measurable business outcome with a pre-pilot baseline." },
    { AB731_DOMAIN_VALUE,
      "Which task is generative rather than predictive?",
      { "Draft a summary", "Score credit risk", "Detect a defect", "Forecast demand" },
      0, "Creating a new summary is a generative AI task." },
    { AB731_DOMAIN_VALUE,
      "When can fine-tuning add value?",
      { "Distinct task behavior", "Change font color", "Reset a password", "Count file names" },
      0, "Fine-tuning can adapt model behavior for a specialized task." },
    { AB731_DOMAIN_VALUE,
      "An AI answer cites a policy that does not exist. This is what risk?",
      { "Fabrication", "Compression", "Authentication", "Scaling" },
      0, "A confident but unsupported answer is a fabrication." },
    { AB731_DOMAIN_VALUE,
      "Where can generative AI create strong business value?",
      { "Repeated content work", "Random approvals", "Hidden ownership", "No quality checks" },
      0, "Repeatable content tasks can benefit from assisted automation." },
    { AB731_DOMAIN_VALUE,
      "A prompt gives a role, context, and audience. Likely benefit?",
      { "More relevant output", "Zero usage cost", "No review needed", "Automatic licensing" },
      0, "Relevant context helps the model produce a better-targeted response." },
    { AB731_DOMAIN_VALUE,
      "You need a fixed response pattern. Which prompt technique helps?",
      { "Provide examples", "Remove constraints", "Hide the goal", "Use random terms" },
      0, "Examples show the model the desired pattern and level of detail." },
    { AB731_DOMAIN_VALUE,
      "A grounded assistant uses old policies. What should improve first?",
      { "Source freshness", "Logo size", "Screen timeout", "Voice pitch" },
      0, "Grounding is only useful when the retrieved sources are current." },
    { AB731_DOMAIN_VALUE,
      "What does RAG do before generating an answer?",
      { "Retrieves context", "Fine-tunes hardware", "Creates passwords", "Deletes sources" },
      0, "RAG retrieves relevant information to use as grounding context." },
    { AB731_DOMAIN_VALUE,
      "Duplicate and conflicting records mainly harm what?",
      { "Data quality", "Display speed", "User licensing", "Network color" },
      0, "Inconsistent records reduce the quality of model inputs and results." },
    { AB731_DOMAIN_VALUE,
      "Customer emails and call notes are primarily what data type?",
      { "Unstructured text", "Numeric labels", "Device firmware", "Access tokens" },
      0, "Natural-language messages and notes are unstructured text." },
    { AB731_DOMAIN_VALUE,
      "Why should evaluation data represent real users?",
      { "Expose uneven quality", "Increase font size", "Remove governance", "Avoid baselines" },
      0, "Representative data reveals performance differences across use cases." },
    { AB731_DOMAIN_VALUE,
      "A secure AI app should give each user what data access?",
      { "Only required access", "All company data", "Anonymous admin", "Shared passwords" },
      0, "Least-privilege access limits unnecessary data exposure." },
    { AB731_DOMAIN_VALUE,
      "Why authenticate users before grounded retrieval?",
      { "Enforce permissions", "Raise creativity", "Lower screen power", "Change model size" },
      0, "Identity enables the solution to enforce source permissions." },
    { AB731_DOMAIN_VALUE,
      "Which control helps defend an AI app from hostile input?",
      { "Input validation", "Longer slogans", "Open admin rights", "No logging" },
      0, "Input validation is part of protecting the application boundary." },
    { AB731_DOMAIN_VALUE,
      "Sensitive grounding data should be protected by what?",
      { "Access and encryption", "Public links", "Shared accounts", "No retention plan" },
      0, "Access controls and encryption protect sensitive data." },
    { AB731_DOMAIN_VALUE,
      "What comes first in a machine learning lifecycle?",
      { "Define the problem", "Deploy the model", "Buy more GPUs", "Publish a logo" },
      0, "Start by defining the business problem and success criteria." },
    { AB731_DOMAIN_VALUE,
      "Before training a model, what data step is essential?",
      { "Prepare the data", "Launch globally", "Remove labels", "Skip quality checks" },
      0, "Training depends on relevant, prepared, and quality-checked data." },
    { AB731_DOMAIN_VALUE,
      "What happens during model training?",
      { "Patterns are learned", "Users are licensed", "Policies are deleted", "Apps are branded" },
      0, "Training adjusts the model from patterns in training data." },
    { AB731_DOMAIN_VALUE,
      "What should happen before production deployment?",
      { "Evaluate performance", "Hide limitations", "Remove monitoring", "Ignore edge cases" },
      0, "Evaluation checks whether the model meets agreed criteria." },
    { AB731_DOMAIN_VALUE,
      "After deployment, why monitor an ML solution?",
      { "Detect quality drift", "Increase logo size", "Remove owners", "Avoid feedback" },
      0, "Monitoring can reveal drift, failures, and changing data." },
    { AB731_DOMAIN_VALUE,
      "A model degrades as customer behavior changes. What is this?",
      { "Model drift", "Grounding", "Authentication", "Tokenization" },
      0, "Changing real-world patterns can cause model performance to drift." },
    { AB731_DOMAIN_VALUE,
      "A real-time app needs fast answers. What matters in model choice?",
      { "Latency", "Office layout", "Badge color", "File name" },
      0, "Response latency is a key requirement for interactive workloads." },
    { AB731_DOMAIN_VALUE,
      "How can a team reduce avoidable token cost?",
      { "Keep context relevant", "Repeat every document", "Max all outputs", "Ignore usage" },
      0, "Relevant context and bounded outputs avoid unnecessary tokens." },
    { AB731_DOMAIN_VALUE,
      "A pilot aims to reduce handling time. What should be tracked?",
      { "Time per case", "Model logo", "Prompt author age", "Monitor size" },
      0, "Time per case directly measures the intended business outcome." },
    { AB731_DOMAIN_VALUE,
      "For a high-impact decision, what safeguard is most appropriate?",
      { "Human review", "Blind automation", "No appeal", "Hidden criteria" },
      0, "Human oversight is important when errors can cause serious harm." },
    { AB731_DOMAIN_VALUE,
      "How should a team test for bias?",
      { "Compare user groups", "Test one example", "Hide results", "Remove labels" },
      0, "Comparing outcomes across representative groups can expose bias." },
    { AB731_DOMAIN_VALUE,
      "What improves confidence in an AI answer process?",
      { "Repeatable evaluation", "One perfect demo", "No test set", "Secret ownership" },
      0, "Repeatable evaluation measures reliability beyond a single demo." },
    { AB731_DOMAIN_VALUE,
      "Raising model creativity does not replace what?",
      { "Grounding", "A theme color", "A larger screen", "A channel logo" },
      0, "Creativity settings cannot provide verified business facts." },
    { AB731_DOMAIN_VALUE,
      "Which need is well suited to traditional machine learning?",
      { "Predict late orders", "Draft a poem", "Write a slogan", "Summarize a memo" },
      0, "Predicting an outcome from historical features is a classic ML use." },
    { AB731_DOMAIN_VALUE,
      "Which need is well suited to generative AI?",
      { "Summarize interviews", "Read a fixed sensor", "Sort IDs", "Check a checksum" },
      0, "Summarization creates new text from supplied content." },
    { AB731_DOMAIN_VALUE,
      "A complete ROI view compares benefits with what?",
      { "Total solution cost", "Only token price", "Model popularity", "Team size only" },
      0, "ROI compares measurable value with implementation and operating cost." },
    { AB731_DOMAIN_VALUE,
      "Why can AI improve scalability in a service process?",
      { "Handles repeated demand", "Removes all policies", "Guarantees truth", "Needs no data" },
      0, "AI assistance can support repeated demand across many interactions." },
    { AB731_DOMAIN_VALUE,
      "A prompt asks for an executive brief. What should it specify?",
      { "Audience and length", "Random vocabulary", "Hidden sources", "No objective" },
      0, "Audience and length are useful output constraints." },

    { AB731_DOMAIN_APPS,
      "Leaders need a sourced report across files and the web. Choose?",
      { "Analyst", "Researcher", "Designer", "Clipchamp" },
      1, "Researcher supports multi-step, source-grounded research." },
    { AB731_DOMAIN_APPS,
      "Finance needs trends and explainable calculations from tables. Choose?",
      { "Analyst", "Researcher", "Designer", "Azure DNS" },
      0, "Analyst is designed for data reasoning and calculations." },
    { AB731_DOMAIN_APPS,
      "Build a low-code agent that calls workflows across channels. Use?",
      { "Paint", "Copilot Studio", "Intune", "Windows Backup" },
      1, "Copilot Studio builds and connects custom agents and actions." },
    { AB731_DOMAIN_APPS,
      "Which API accesses permitted Microsoft 365 people, mail, and files?",
      { "Microsoft Graph", "Azure Firewall", "Windows Registry", "PowerShell Gallery" },
      0, "Microsoft Graph is the unified API for Microsoft 365 data." },
    { AB731_DOMAIN_APPS,
      "Which service indexes enterprise content for a RAG solution?",
      { "Azure AI Search", "Azure DNS", "Intune", "Virtual Desktop" },
      0, "Azure AI Search provides indexing and retrieval for grounding." },
    { AB731_DOMAIN_APPS,
      "Copilot must query an internal order system. Best decision?",
      { "Extend with connector", "Remove authentication", "Copy data by hand", "Train a base model" },
      0, "Extend the existing experience with governed data and actions." },
    { AB731_DOMAIN_APPS,
      "Why combine Microsoft AI services in one governed solution?",
      { "Remove all reviews", "Shared security controls", "Avoid business goals", "Hide usage" },
      1, "Integrated controls can improve security, safety, and governance." },
    { AB731_DOMAIN_APPS,
      "Where does Microsoft 365 Copilot provide in-flow assistance?",
      { "Microsoft 365 apps", "Only BIOS setup", "Only public websites", "Printer firmware" },
      0, "Microsoft 365 Copilot works within supported Microsoft 365 experiences." },
    { AB731_DOMAIN_APPS,
      "A user needs Copilot while away from a desk. Which access fits?",
      { "Web or mobile", "Server console only", "BIOS only", "Printed prompt only" },
      0, "Copilot web and mobile experiences support flexible access." },
    { AB731_DOMAIN_APPS,
      "Which app is best for drafting and revising a business document?",
      { "Word", "Azure DNS", "Intune", "Defender Firewall" },
      0, "Copilot in Word supports document drafting and revision workflows." },
    { AB731_DOMAIN_APPS,
      "Which app best fits analysis of a business table?",
      { "Excel", "OneNote drawing", "Clipchamp", "Windows Settings" },
      0, "Copilot in Excel supports analysis in spreadsheet workflows." },
    { AB731_DOMAIN_APPS,
      "Which app best fits turning an outline into slides?",
      { "PowerPoint", "Azure DNS", "Calculator", "File Explorer" },
      0, "Copilot in PowerPoint supports presentation creation workflows." },
    { AB731_DOMAIN_APPS,
      "Which app best fits summarizing a long email thread?",
      { "Outlook", "Paint", "Terminal", "Device Manager" },
      0, "Copilot in Outlook supports email summarization and drafting." },
    { AB731_DOMAIN_APPS,
      "Which app best fits recapping a collaborative meeting?",
      { "Teams", "Notepad", "Azure DNS", "Registry Editor" },
      0, "Copilot in Teams supports meeting and collaboration workflows." },
    { AB731_DOMAIN_APPS,
      "A standard need is already met by Copilot. Best strategy?",
      { "Buy and configure", "Build from zero", "Ignore the need", "Remove identity" },
      0, "Use an existing product when it meets the business requirement." },
    { AB731_DOMAIN_APPS,
      "An existing Copilot lacks company data. Best strategy?",
      { "Extend it", "Replace all systems", "Share passwords", "Disable permissions" },
      0, "Extension connects governed business context to an existing experience." },
    { AB731_DOMAIN_APPS,
      "A unique AI product needs custom orchestration. Best strategy?",
      { "Build with Foundry", "Use a static poster", "Remove testing", "Copy emails" },
      0, "A custom solution fits needs beyond an existing packaged experience." },
    { AB731_DOMAIN_APPS,
      "Which tool fits a multi-source market investigation?",
      { "Researcher", "Analyst", "Paint", "Calculator" },
      0, "Researcher is intended for deep, source-grounded investigation." },
    { AB731_DOMAIN_APPS,
      "Which tool fits calculations and patterns in uploaded data?",
      { "Analyst", "Researcher", "Clipchamp", "Designer" },
      0, "Analyst focuses on data reasoning, calculations, and insights." },
    { AB731_DOMAIN_APPS,
      "Why must Graph calls use the signed-in user's permissions?",
      { "Respect data access", "Increase creativity", "Avoid all logs", "Change language" },
      0, "Permission-aware access helps prevent exposure of unauthorized data." },
    { AB731_DOMAIN_APPS,
      "A custom agent must run an approval flow. Which feature helps?",
      { "Studio actions", "Wallpaper themes", "Screen capture", "Font embedding" },
      0, "Copilot Studio actions can connect an agent to business processes." },
    { AB731_DOMAIN_APPS,
      "A custom agent must serve more than one channel. Use what?",
      { "Copilot Studio", "Paint", "Disk Cleanup", "BIOS tools" },
      0, "Copilot Studio supports building and publishing agent experiences." },
    { AB731_DOMAIN_APPS,
      "Which retrieval service supports semantic and vector search?",
      { "Azure AI Search", "Azure DNS", "Azure Backup", "Windows Update" },
      0, "Azure AI Search supports retrieval patterns used in grounded AI." },
    { AB731_DOMAIN_APPS,
      "A process must extract meaning from product images. Which tool fits?",
      { "Azure Vision", "Azure DNS", "Outlook rules", "BitLocker" },
      0, "Azure Vision in Foundry Tools supports image analysis scenarios." },
    { AB731_DOMAIN_APPS,
      "Where can a team compare models for a custom AI solution?",
      { "Microsoft Foundry", "Windows Settings", "SharePoint theme", "Printer queue" },
      0, "Microsoft Foundry supports model selection and solution development." },
    { AB731_DOMAIN_APPS,
      "A solution must understand text and images. Choose what model type?",
      { "Multimodal model", "Text-only index", "Fixed formula", "DNS resolver" },
      0, "A multimodal model can work across more than one content type." },
    { AB731_DOMAIN_APPS,
      "A high-volume simple task values speed and cost. Consider what?",
      { "Smaller capable model", "Largest model only", "No evaluation", "Manual copying" },
      0, "Choose the smallest model that reliably meets the requirement." },
    { AB731_DOMAIN_APPS,
      "What Foundry benefit helps a pilot grow to wider use?",
      { "Scalability", "Anonymous admin", "No monitoring", "Hidden cost" },
      0, "A scalable platform supports growth from pilot to production demand." },
    { AB731_DOMAIN_APPS,
      "What Foundry benefit matters for sensitive enterprise workloads?",
      { "Security controls", "Public passwords", "No ownership", "Untracked data" },
      0, "Enterprise security controls help protect applications and data." },
    { AB731_DOMAIN_APPS,
      "How should a leader compare Copilot options?",
      { "Match needs and access", "Choose by logo", "Ignore licensing", "Assume all equal" },
      0, "Capabilities, data access, and licensing must match the use case." },
    { AB731_DOMAIN_APPS,
      "Why use an integrated Microsoft AI solution?",
      { "Consistent safeguards", "No accountability", "Unlimited data", "No evaluation" },
      0, "Integrated controls can apply safety and risk measures consistently." },
    { AB731_DOMAIN_APPS,
      "A common productivity need has a proven product. Prefer what?",
      { "Buy", "Build a base model", "Remove controls", "Duplicate the data" },
      0, "Buying is efficient when an existing product meets the need." },
    { AB731_DOMAIN_APPS,
      "A solution depends on unique company intellectual property. Prefer?",
      { "Build", "Use random output", "Publish the data", "Skip security" },
      0, "A custom build may fit differentiated requirements and controls." },
    { AB731_DOMAIN_APPS,
      "Users work in Microsoft 365 but need one extra action. Prefer?",
      { "Extend", "Replace Microsoft 365", "Build new hardware", "Remove workflow" },
      0, "Extension preserves the existing work surface while adding capability." },
    { AB731_DOMAIN_APPS,
      "What is a benefit of a Copilot mobile experience?",
      { "Access on the move", "No identity needed", "Unlimited permissions", "No network ever" },
      0, "Mobile access supports work when users are away from a desktop." },
    { AB731_DOMAIN_APPS,
      "Microsoft Graph provides a unified way to work with what?",
      { "Microsoft 365 data", "BIOS firmware", "Public DNS only", "Screen pixels" },
      0, "Graph exposes permitted Microsoft 365 data through a unified API." },
    { AB731_DOMAIN_APPS,
      "Before choosing a Foundry model, what should a team define?",
      { "Quality criteria", "Badge color", "Office seating", "File wallpaper" },
      0, "Quality, cost, latency, and modality requirements guide model choice." },
    { AB731_DOMAIN_APPS,
      "After a Foundry solution launches, what remains important?",
      { "Monitor outcomes", "Delete owners", "Stop evaluation", "Hide incidents" },
      0, "Production monitoring helps maintain quality, safety, and value." },

    { AB731_DOMAIN_ADOPTION,
      "Who oversees cross-functional AI strategy and major risks?",
      { "One intern", "AI council", "Only the vendor", "Each user alone" },
      1, "A cross-functional AI council aligns strategy and oversight." },
    { AB731_DOMAIN_ADOPTION,
      "What is the main role of an AI champions program?",
      { "Replace security", "Buy every license", "Help peers adopt", "Hide metrics" },
      2, "Champions share practices, help peers, and return feedback." },
    { AB731_DOMAIN_ADOPTION,
      "Copilot pilot usage is low. What should a leader do first?",
      { "Scale immediately", "Find adoption barriers", "Remove policies", "Raise temperature" },
      1, "Identify workflow, trust, skill, and data barriers before scaling." },
    { AB731_DOMAIN_ADOPTION,
      "Which is a Microsoft responsible AI principle?",
      { "Vendor lock-in", "Opacity", "Accountability", "Maximum automation" },
      2, "Accountability is one of Microsoft's responsible AI principles." },
    { AB731_DOMAIN_ADOPTION,
      "Two groups receive uneven model quality. Which principle applies?",
      { "Fairness", "Branding", "Compression", "Convenience" },
      0, "Fairness addresses unjust differences in AI outcomes." },
    { AB731_DOMAIN_ADOPTION,
      "A critical AI process needs stable behavior and recovery. Principle?",
      { "Reliability and safety", "Opacity", "Popularity", "Maximum output" },
      0, "Reliable and safe systems should perform consistently and handle failure." },
    { AB731_DOMAIN_ADOPTION,
      "An adoption plan handles personal data. What must be assessed?",
      { "Privacy and security", "Logo spacing", "Office paint", "Slide count" },
      0, "AI adoption must address privacy and security impacts." },
    { AB731_DOMAIN_ADOPTION,
      "An AI tool excludes users with assistive needs. Which principle?",
      { "Inclusiveness", "Profitability", "Tokenization", "Scalability" },
      0, "Inclusiveness requires designing AI experiences for diverse users." },
    { AB731_DOMAIN_ADOPTION,
      "Users should know when AI influenced an output. Which principle?",
      { "Transparency", "Secrecy", "Speed", "Compression" },
      0, "Transparency helps people understand AI use and limitations." },
    { AB731_DOMAIN_ADOPTION,
      "What should an acceptable-use policy define?",
      { "Allowed and blocked uses", "Only font choice", "No ownership", "Public passwords" },
      0, "Governance should clearly define acceptable uses and boundaries." },
    { AB731_DOMAIN_ADOPTION,
      "Who should an AI adoption team include?",
      { "Business and risk roles", "Only one developer", "Only the vendor", "No users" },
      0, "Cross-functional roles connect value, technology, risk, and change." },
    { AB731_DOMAIN_ADOPTION,
      "Who should participate in an early pilot?",
      { "Representative users", "Only executives", "Only AI experts", "No end users" },
      0, "Representative users provide realistic workflow and adoption evidence." },
    { AB731_DOMAIN_ADOPTION,
      "What training approach best supports adoption?",
      { "Role-based practice", "One generic memo", "No examples", "Hide limitations" },
      0, "Role-based practice connects the tool to real work." },
    { AB731_DOMAIN_ADOPTION,
      "What should champions send back to the adoption team?",
      { "User feedback", "Shared passwords", "Untracked data", "Only praise" },
      0, "A feedback loop helps improve guidance, controls, and workflows." },
    { AB731_DOMAIN_ADOPTION,
      "Which measure best shows adoption value?",
      { "Agreed business KPI", "Login count alone", "Model popularity", "Prompt length" },
      0, "Adoption should be linked to a defined business outcome." },
    { AB731_DOMAIN_ADOPTION,
      "When should a successful pilot scale?",
      { "After evidence and controls", "Before evaluation", "After removing owners", "Without budget" },
      0, "Scale after value, readiness, risk controls, and support are proven." },
    { AB731_DOMAIN_ADOPTION,
      "Usage varies greatly month to month. Which model may fit?",
      { "Pay as you go", "Fixed paper license", "No cost tracking", "Unlimited free use" },
      0, "Pay-as-you-go can align cost with variable consumption." },
    { AB731_DOMAIN_ADOPTION,
      "Usage is stable and predictable. What may be evaluated?",
      { "Commitment tier", "Anonymous access", "No subscription", "Shared password" },
      0, "A commitment tier may suit predictable Foundry usage." },
    { AB731_DOMAIN_ADOPTION,
      "Before assuming Copilot is included, what should a leader verify?",
      { "License entitlement", "Logo color", "Desk location", "Browser wallpaper" },
      0, "Copilot capabilities depend on the applicable license and terms." },
    { AB731_DOMAIN_ADOPTION,
      "Employees fear AI will replace them. What should leaders do?",
      { "Explain purpose and roles", "Hide the plan", "Force full rollout", "Ignore concerns" },
      0, "Clear change communication addresses concerns and expected ways of working." },
    { AB731_DOMAIN_ADOPTION,
      "What should be checked before grounding a company-wide assistant?",
      { "Data readiness", "Mascot design", "Office lighting", "Slide animation" },
      0, "Quality, permissions, ownership, and freshness affect safe adoption." },
    { AB731_DOMAIN_ADOPTION,
      "An AI solution causes a harmful error. What should exist?",
      { "Escalation and owner", "No audit trail", "Hidden incident", "Automatic deletion" },
      0, "Accountability requires clear ownership, escalation, and response." },
